## boards/arm/chiri_ce/Kconfig.board
```kconfig
config BOARD_CHIRI_CE_LEFT
    bool "Chiri CE left"
    depends on SOC_RP2040

config BOARD_CHIRI_CE_RIGHT
    bool "Chiri CE right"
    depends on SOC_RP2040
```

## boards/arm/chiri_ce/Kconfig.defconfig
```kconfig
if BOARD_CHIRI_CE_LEFT

config ZMK_KEYBOARD_NAME
    default "Chiri CE Rev. 1"

config ZMK_SPLIT_ROLE_CENTRAL
    default y

endif

if BOARD_CHIRI_CE_LEFT || BOARD_CHIRI_CE_RIGHT

config BOARD
    default "chiri_ce"

config RP2_FLASH_W25Q080
    default y

config ZMK_SPLIT
    default y

if ZMK_RGB_UNDERGLOW

config WS2812_STRIP
    default y

endif

endif
```

## boards/arm/chiri_ce/chiri_ce_right_defconfig
```kconfig
CONFIG_SOC_SERIES_RP2XXX=y
CONFIG_SOC_RP2040=y
CONFIG_BOARD_CHIRI_CE_RIGHT=y
CONFIG_USB_DEVICE_MANUFACTURER="Keebio"
CONFIG_USB_DEVICE_VID=0xCB10
CONFIG_USB_DEVICE_PID=0x1546

CONFIG_SYS_CLOCK_HW_CYCLES_PER_SEC=125000000

# Enable reset by default
CONFIG_RESET=y

# Flash Settings
CONFIG_USE_DT_CODE_PARTITION=y

# Output UF2 by default
CONFIG_BUILD_OUTPUT_UF2=y

CONFIG_ZMK_BLE=n
CONFIG_ZMK_USB=y

CONFIG_ZMK_SPLIT_WIRED_UART_MODE_DEFAULT_POLLING=y
CONFIG_ZMK_SPLIT_WIRED_POLLING_RX_PERIOD=3
CONFIG_MAIN_STACK_SIZE=2048
```

## config/west.yml
```yaml
manifest:
  remotes:
    - name: zmkfirmware
      url-base: https://github.com/zmkfirmware
    # Additional modules containing boards/shields/custom code can be listed here as well
    # See https://docs.zephyrproject.org/3.2.0/develop/west/manifest.html#projects
    - name: ssheldon
      url-base: https://github.com/SSheldon
  projects:
    - name: zmk
      remote: ssheldon
      revision: pr2766
      import: app/west.yml
  self:
    path: config
```
